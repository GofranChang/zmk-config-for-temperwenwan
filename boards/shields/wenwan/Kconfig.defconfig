## boards/shields/wenwan/Kconfig.defconfig
```kconfig
if SHIELD_WENWAN_LEFT

config ZMK_KEYBOARD_NAME
    default "wenwan"

config ZMK_SPLIT_ROLE_CENTRAL
    default y

endif # SHIELD_WENWAN_LEFT

if SHIELD_WENWAN_LEFT || SHIELD_WENWAN_RIGHT

config ZMK_SPLIT
    default y

endif # SHIELD_WENWAN_LEFT || SHIELD_WENWAN_RIGHT
```

## boards/shields/wenwan/Kconfig.shield
```kconfig
config SHIELD_WENWAN_LEFT
    def_bool $(shields_list_contains,wenwan_left)

config SHIELD_WENWAN_RIGHT
    def_bool $(shields_list_contains,wenwan_right)
```
